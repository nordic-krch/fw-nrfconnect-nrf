## CMakeLists.txt
```
cmake_minimum_required(VERSION 3.13.1)
include($ENV{ZEPHYR_BASE}/../nrf/tests/unity/unity_test.cmake)
project(crc)

FILE(GLOB app_sources src/*.c)
target_sources(app PRIVATE ${app_sources})
target_include_directories(app PRIVATE .)

test_runner_generate(src/nus_test.c)
cmock_handle(${ZEPHYR_BASE}/include/bluetooth/gatt.h bluetooth)

#set_property(SOURCE src/nus_test.c PROPERTY COMPILE_FLAGS "-include ${PROJECT_SOURCE_DIR}/src/test.h")
set_property(SOURCE build/unity/mocks/bluetooth/mock_gatt.c PROPERTY COMPILE_FLAGS "-include src/test.h")
```

## prj.conf
```kconfig
CONFIG_UNITY=y
CONFIG_BT_GATT_NUS=y
CONFIG_BT=y
CONFIG_BT_PERIPHERAL=y
```

## src/nus_test.c
```c
#include <zephyr.h>
#include <unity.h>
#include <bluetooth/services/nus.h>
#include "bluetooth/mock_gatt.h"

void nus_received_cb(const u8_t *const data, u16_t len)
{
	printf("asdsadas\n");
}

void nus_sent_cb(const u8_t *data, u16_t len)
{
	printf("asdsadas\n");

}

void test_nus_init(void)
{
//	u8_t buf[8];
	struct bt_nus_cb callbacks = {
		.received_cb = nus_received_cb,
		.sent_cb = nus_sent_cb
	};
	struct bt_gatt_service nus_svc;

	__wrap_bt_gatt_service_register_ExpectAndReturn(NULL, 0);
	__wrap_bt_gatt_service_register_IgnoreArg_svc();
	__wrap_bt_gatt_service_register_ReturnThruPtr_svc(&nus_svc);

	nus_init(&callbacks);

}
```

## src/test.h
```c
#ifndef __NUS_TEST_H
#define __NUS_TEST_H
struct bt_conn {
	int x;
};
#endif /*__NUS_TEST_H */
```
