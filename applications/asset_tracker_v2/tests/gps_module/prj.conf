## CMakeLists.txt
```
#
# Copyright (c) 2019 Nordic Semiconductor
#
# SPDX-License-Identifier: LicenseRef-Nordic-5-Clause
#

cmake_minimum_required(VERSION 3.13.1)

find_package(Zephyr REQUIRED HINTS $ENV{ZEPHYR_BASE})
project(gps_module_test)

# generate runner for the test
test_runner_generate(src/gps_module_test.c)

# create mock
cmock_handle(${ZEPHYR_BASE}/../nrf/include/event_manager.h )
cmock_handle(${ZEPHYR_BASE}/../nrf/include/date_time.h )
cmock_handle(${ZEPHYR_BASE}/../nrf/include/drivers/gps.h drivers)
cmock_handle(${ZEPHYR_BASE}/../nrf/applications/asset_tracker_v2/src/modules/modules_common.h )


# add gps_module (the UUT)
target_sources(app PRIVATE ../../src/modules/gps_module.c)
target_include_directories(app PRIVATE ../../src/modules/)
target_include_directories(app PRIVATE ${ZEPHYR_BASE}/../nrf/subsys/event_manager)
target_include_directories(app PRIVATE ../../src/)
target_include_directories(app PRIVATE ${ZEPHYR_BASE}/../nrf/modules/cjson/include)
target_include_directories(app PRIVATE ${ZEPHYR_BASE}/../nrf/applications/asset_tracker_v2/src/events/)
target_include_directories(app PRIVATE )

# add test file
target_sources(app PRIVATE src/gps_module_test.c)
target_include_directories(app PRIVATE .)

target_compile_options(app PRIVATE
	-DCONFIG_GPS_DEV_NAME="test"
  	-DCONFIG_ASSET_TRACKER_V2_APP_VERSION_MAX_LEN=20
	-DCONFIG_GPS_MODULE_LOG_LEVEL=4
	-DCONFIG_GPS_DEV_NAME="GPS_SIM")

# Preinclude file to the module under test to redefine IS_ENABLED() macro
# which is used in the module.
#set_property(SOURCE src/uut/uut.c PROPERTY COMPILE_FLAGS
#	"-include src/example_test.h")
```

## Kconfig
```
# Config options for logger sample app
#
# Copyright (c) 2019 Nordic Semiconductor ASA
#
# SPDX-License-Identifier: LicenseRef-Nordic-5-Clause
#

mainmenu "GPS Module unity test"

menu "GPS Module configuration"

config UUT_PARAM_CHECK
	bool "Enabled function parameter check"

endmenu

source "Kconfig.zephyr"
```

## sample.yaml
```
sample:
  description: GPS Module test using Unity/Cmock
  name: gps_module_test
```

## prj.conf
```kconfig
#
# Copyright (c) 2019 Nordic Semiconductor ASA
#
# SPDX-License-Identifier: LicenseRef-Nordic-5-Clause
#
CONFIG_UNITY=y
CONFIG_LOG=y
CONFIG_DEBUG_OPTIMIZATIONS=y
CONFIG_GPS_SIM=n
```

## src/gps_module_test.c
```c
/*
 * Copyright (c) 2019 Nordic Semiconductor ASA
 *
 * SPDX-License-Identifier: LicenseRef-Nordic-5-Clause
 */
#include <unity.h>
#include <stdbool.h>
#include <stdlib.h>
#include <mock_modules_common.h>
#include <mock_event_manager.h>
#include <drivers/mock_gps.h>
#include "app_module_event.h"
#include "gps_module_event.h"
#include "data_module_event.h"

extern struct event_listener __event_listener_gps_module;

#define GPS_MODULE_EVT_HANDLER(eh) __event_listener_gps_module.notification(eh)

/* Dummy functions and objects. */

void sys_reboot(int reason)
{
}

void *k_malloc(size_t size)
{
	return malloc(size);
}

/* Dummy structs to please linker. The EVENT_SUBSCRIBE macros in gps_module.c
 * depend on these to exist. But since we are unit testing, we dont need
 * these subscriptions.
 */
const struct event_type __event_type_gps_module_event;
const struct event_type __event_type_app_module_event;
const struct event_type __event_type_data_module_event;
const struct event_type __event_type_util_module_event;

/** Dummy functions and objects - End.  **/

/* Suite teardown shall finalize with mandatory call to generic_suiteTearDown. */
extern int generic_suiteTearDown(int num_failures);


int test_suiteTearDown(int num_failures)
{
	return generic_suiteTearDown(num_failures);
}


static void setup_gps_module_in_init_state(void)
{
	struct app_module_event *app_module_event = new_app_module_event();

	app_module_event->type = APP_EVT_START;

	static struct module_data expected_module_data = {
		.name = "gps",
		.msg_q = NULL,
		.supports_shutdown = true,
	};

	__wrap_module_start_ExpectAndReturn(&expected_module_data, 0);

	bool ret = GPS_MODULE_EVT_HANDLER((struct event_header *)app_module_event);
	TEST_ASSERT_EQUAL(0, ret);

	free(app_module_event);
}

static void setup_gps_module_in_running_state()
{
	setup_gps_module_in_init_state();

	struct data_module_event *data_module_event = new_data_module_event();

	data_module_event->type = DATA_EVT_CONFIG_INIT;
	data_module_event->data.cfg.gps_timeout = 60;

	bool ret = GPS_MODULE_EVT_HANDLER((struct event_header *)data_module_event);
	TEST_ASSERT_EQUAL(0, ret);

	free(data_module_event);
}

/* Test whether sending a APP_EVT_DATA_GET event to the GPS module generates
 * the GPS_EVT_ACTIVE event, when the GPS module is in the running state. */
void test_gps_start(void)
{
	__wrap_gps_start_IgnoreAndReturn(0);
	/* Pre-condition. */
	setup_gps_module_in_running_state();

	/* Setup expectations. */
	struct gps_module_event *exp_event = new_gps_module_event();
	exp_event->type = GPS_EVT_ACTIVE;

	__wrap__event_submit_Expect((struct event_header *)exp_event);

	/* Stimulus. */
	struct app_module_event *app_module_event = new_app_module_event();

	app_module_event->type = APP_EVT_DATA_GET;
	app_module_event->count = 1;
	app_module_event->data_list[0] = APP_DATA_GNSS;

	bool ret = GPS_MODULE_EVT_HANDLER((struct event_header *)app_module_event);
	TEST_ASSERT_EQUAL(0, ret);

	/* Cleanup */
	free(app_module_event);
}


/* It is required to be added to each test. That is because unity is using
 * different main signature (returns int) and zephyr expects main which does
 * not return value.
 */
extern int unity_main(void);

void main(void)
{
	__wrap_gps_init_IgnoreAndReturn(0);
	(void)unity_main();
}
```
