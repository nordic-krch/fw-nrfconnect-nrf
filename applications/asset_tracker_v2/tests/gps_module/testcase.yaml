## nrf5_sdk/Kconfig
```kconfig
menuconfig NRF5_SDK
	bool "nRF5 SDK"

if NRF5_SDK

config MULTITHREADING
    default n

rsource "ble/Kconfig"
rsource "softdevice/Kconfig"
rsource "libraries/Kconfig"
endif
```

## samples/zigbee/shell/sample.yaml
```yaml
sample:
  description: Zigbee application that includes all Zigbee shell commands
  name: Zigbee application with Zigbee shell
tests:
  sample.zigbee.shell:
    build_only: true
    integration_platforms:
      - nrf52840dk_nrf52840
      - nrf52833dk_nrf52833
      - nrf5340dk_nrf5340_cpuapp
      - nrf21540dk_nrf52840
    platform_allow: nrf52840dk_nrf52840 nrf52833dk_nrf52833 nrf5340dk_nrf5340_cpuapp
      nrf21540dk_nrf52840
    tags: ci_build shell
  sample.zigbee.nrf52840dk_nrf52840.shell.usb:
    build_only: true
    extra_args:
      CONF_FILE=prj_usb.conf
      DTC_OVERLAY_FILE="app_usb.overlay;boards/nrf52840dk_nrf52840.overlay"
    integration_platforms:
      - nrf52840dk_nrf52840
    platform_allow: nrf52840dk_nrf52840
    tags: ci_build shell
  sample.zigbee.nrf21540dk_nrf52840.shell.usb:
    build_only: true
    extra_args:
      CONF_FILE=prj_usb.conf
      DTC_OVERLAY_FILE="app_usb.overlay;boards/nrf21540dk_nrf52840.overlay"
    integration_platforms:
      - nrf21540dk_nrf52840
    platform_allow: nrf21540dk_nrf52840
    tags: ci_build shell
  sample.zigbee.nrf52833dk_nrf52833.shell.usb:
    build_only: true
    extra_args:
      CONF_FILE=prj_usb.conf
      DTC_OVERLAY_FILE="app_usb.overlay;boards/nrf52833dk_nrf52833.overlay"
    integration_platforms:
      - nrf52833dk_nrf52833
    platform_allow: nrf52833dk_nrf52833
    tags: ci_build shell
  sample.zigbee.nrf52840dongle_nrf52840.shell.usb:
    build_only: true
    extra_args:
      CONF_FILE=prj_usb.conf
      DTC_OVERLAY_FILE="app_usb.overlay;boards/nrf52840dongle_nrf52840.overlay"
    integration_platforms:
      - nrf52840dongle_nrf52840
    platform_allow: nrf52840dongle_nrf52840
    tags: ci_build shell
  sample.zigbee.nrf5340dk_nrf5340_cpuapp.shell.usb:
    build_only: true
    extra_args:
      CONF_FILE=prj_usb.conf
      DTC_OVERLAY_FILE="app_usb.overlay;boards/nrf5340dk_nrf5340_cpuapp.overlay"
    integration_platforms:
      - nrf5340dk_nrf5340_cpuapp
    platform_allow: nrf5340dk_nrf5340_cpuapp
    tags: ci_build shell
```

## subsys/logging/Kconfig
```kconfig
if LOG

config LOG_BACKEND_TZ_S
	bool "Enable TrustZone Secure log backend"
	depends on ARM_SECURE_FIRMWARE

if LOG_MULTIDOMAIN

config LOG_LINK_TZ_S
	bool "Enable link to TrustZone Secure log backend"
	depends on ARM_NONSECURE_FIRMWARE

endif #LOG_MULTIDOMAIN
endif #LOG
```

## subsys/shell/Kconfig
```kconfig
#
# Copyright (c) 2018 Nordic Semiconductor
#
# SPDX-License-Identifier: LicenseRef-BSD-5-Clause-Nordic
#

menuconfig SHELL_BT_NUS
	bool
	prompt "Shell Bluetooth NUS transport"
	depends on BT
	select SHELL
	select BT_GATT_NUS
	select RING_BUFFER
	help
	  Enable shell BT NUS transport.

if SHELL_BT_NUS

module = SHELL_BT_NUS
module-str = Shell over Bleutooth NUS
source "${ZEPHYR_BASE}/subsys/logging/Kconfig.template.log_config"

endif #SHELL_BT_NUS
```

## tests/unity/example_test/Kconfig
```kconfig
# Kconfig - Config options for logger sample app
#
# Copyright (c) 2018 Nordic Semiconductor ASA
#
# SPDX-License-Identifier: LicenseRef-BSD-5-Clause-Nordic
#

mainmenu "Example unity test"

menu "UUT module configuration"

config UUT_PARAM_CHECK
	bool "Function parameter check"

endmenu

source "Kconfig.zephyr"
```
