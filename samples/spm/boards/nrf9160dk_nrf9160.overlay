/* SPDX-License-Identifier: LicenseRef-Nordic-5-Clause */

/ {
	chosen {
		zephyr,console=&spm_uart;
	};
};

&uart0 {
	status = "okay";

	spm_uart: nrf-spm-uart {
		compatible = "nordic,nrf-spm-uart";
		status = "okay";
		label = "LPUART";
	};
};
