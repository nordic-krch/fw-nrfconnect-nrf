## prj.conf
```kconfig
#
# Copyright (c) 2020 Nordic Semiconductor
#
# SPDX-License-Identifier: LicenseRef-Nordic-5-Clause
#
CONFIG_NRF_SW_LPUART=y

# Sample is showing low power capabilities of low power uart module thus
# console/logging uart is disabled.
# Uncomment this section for debugging. Additionally, comment uart0 disabling
# in overlay.

# CONFIG_USE_SEGGER_RTT=n
# CONFIG_LOG=y
# CONFIG_NO_OPTIMIZATIONS=y
# CONFIG_ASSERT=y
# CONFIG_NRF_SW_LPUART_LOG_LEVEL_DBG=y
# CONFIG_LOG_PROCESS_THREAD_STACK_SIZE=2048

# Comment this section for debugging
CONFIG_CONSOLE=n
CONFIG_UART_CONSOLE=n

# Uncomment to use lpuart using interrupt driven API
# CONFIG_NRF_SW_LPUART_INT_DRIVEN=y
```

## boards/nrf52840dk_nrf52840.conf
```kconfig
#
# Copyright (c) 2020 Nordic Semiconductor
#
# SPDX-License-Identifier: LicenseRef-Nordic-5-Clause
#

CONFIG_UART_1_ASYNC=y
CONFIG_UART_1_INTERRUPT_DRIVEN=n
CONFIG_UART_1_NRF_HW_ASYNC=y
CONFIG_UART_1_NRF_ASYNC_LOW_POWER=y
CONFIG_UART_1_NRF_HW_ASYNC_TIMER=2
CONFIG_NRFX_TIMER2=y
```

## src/main.c
```c
/*
 * Copyright (c) 2020 Nordic Semiconductor ASA
 *
 * SPDX-License-Identifier: LicenseRef-BSD-5-Clause-Nordic
 */

#include <zephyr.h>
#include <logging/log.h>
#include <drivers/uart.h>

LOG_MODULE_REGISTER(app);

#define BUF_SIZE 64
static K_MEM_SLAB_DEFINE(uart_slab, BUF_SIZE, 3, 4);

#ifdef CONFIG_UART_INTERRUPT_DRIVEN

static void uart_irq_handler(struct device *dev, void *context)
{
	static int repeat = 3;
	uint8_t buf[] = {1, 2, 3};

	if (uart_irq_tx_ready(dev)) {
		if (repeat > 0) {
			uart_fifo_fill(dev, buf, sizeof(buf));
			repeat --;
		} else {
			uart_irq_tx_disable(dev);
		}
	}

	if (uart_irq_rx_ready(dev)) {
		uint8_t buf[10];
		int len = uart_fifo_read(dev, buf, sizeof(buf));
		if (len) {
			printk("read %d bytes\n", len);
		}
	}
}

void interrupt_driven(struct device *dev)
{
	uart_irq_callback_set(dev, uart_irq_handler);
	uart_irq_tx_enable(dev);
	k_sleep(K_FOREVER);
}

#else

static void uart_callback(struct device *dev,
			  struct uart_event *evt,
			  void *user_data)
{
	struct device *uart = user_data;
	int err;


	switch (evt->type) {
	case UART_TX_DONE:
		LOG_INF("Tx sent %d bytes", evt->data.tx.len);
		break;

	case UART_TX_ABORTED:
		LOG_ERR("Tx aborted");
		break;

	case UART_RX_RDY:
		LOG_INF("Received data %d bytes", evt->data.rx.len);
		break;

	case UART_RX_BUF_REQUEST:
	{
		uint8_t *buf;

		err = k_mem_slab_alloc(&uart_slab, (void **)&buf, K_NO_WAIT);
		__ASSERT(err == 0, "Failed to allocate slab");

		err = uart_rx_buf_rsp(uart, buf, BUF_SIZE);
		__ASSERT(err == 0, "Failed to provide new buffer");
		break;
	}

	case UART_RX_BUF_RELEASED:
		k_mem_slab_free(&uart_slab, (void **)&evt->data.rx_buf.buf);
		break;

	case UART_RX_DISABLED:
		break;

	case UART_RX_STOPPED:
		break;
	}
}

void async(struct device *lpuart)
{
	uint8_t txbuf[5] = {1, 2, 3, 4, 5};
	int err;
	uint8_t *buf;

	err = k_mem_slab_alloc(&uart_slab, (void **)&buf, K_NO_WAIT);
	__ASSERT(err == 0, "Failed to alloc slab");

	err = uart_callback_set(lpuart, uart_callback, lpuart);
	__ASSERT(err == 0, "Failed to set callback");

	err = uart_rx_enable(lpuart, buf, BUF_SIZE, 10);
	__ASSERT(err == 0, "Failed to enable RX");

	while (1) {
		err = uart_tx(lpuart, txbuf, sizeof(txbuf), 10);
		__ASSERT(err == 0, "Failed to initiate transmission");

		k_sleep(K_MSEC(500));
	}
}

#endif

void main(void)
{
	struct device *lpuart;

	k_msleep(1000);

	lpuart = device_get_binding("LPUART");
	__ASSERT(lpuart, "Failed to get the device");

#ifdef CONFIG_NRF_SW_LPUART_INT_DRIVEN
	interrupt_driven(lpuart);
#else
	async(lpuart);
#endif

}
```
