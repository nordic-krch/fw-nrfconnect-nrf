## drivers/sensor_engine/Kconfig
```kconfig
#
# Copyright (c) 2025 Nordic Semiconductor
#
# SPDX-License-Identifier: LicenseRef-Nordic-5-Clause
#

config NRF_SENSOR_ENGINE
	bool "Sensor engine"
	select NRFX_GPPI
	select NRFX_TIMER
	help
	  Sensor engine allows to perform periodic SPI operations (like reading the
	  sensor data) offloading CPU and reducing power consumption.
```

## lib/ppi_seq/Kconfig
```kconfig
#
# Copyright (c) 2026 Nordic Semiconductor
#
# SPDX-License-Identifier: LicenseRef-Nordic-5-Clause
#

config PPI_SEQ
	bool "PPI Sequencer"
	select NRFX_GPPI
	select NRFX_TIMER
	help
	  PPI sequencer is a module for periodically triggering hardware tasks
	  (like SPI transfer) using PPI and timing source (GRTC, TIMER or RTC).

config PPI_SEQ_SPIM
	bool "SPIM transfers"
	select NRFX_SPIM

config PPI_SEQ_TWIM
	bool "SPIM transfers"
	select NRFX_TWIM

config PPI_SEQ_MAX_PPI_HANDLES
	def_int 8
```

## samples/bluetooth/throughput/sysbuild/ipc_radio/boards/nrf5340dk_nrf5340_cpunet_icmsg.conf
```kconfig
#
# Copyright (c) 2026 Nordic Semiconductor ASA
#
# SPDX-License-Identifier: LicenseRef-Nordic-5-Clause
#

CONFIG_IPC_SERVICE_BACKEND_ICMSG=y
CONFIG_PBUF_RX_READ_BUF_SIZE=512
```

## tests/lib/ppi_seq/i2c/testcase.yaml
```yaml
tests:
  drivers.ppi_seq.i2c:
    depends_on: i2c
    tags:
      - drivers
      - spi
    harness: ztest
    harness_config:
      fixture: gpio_spi_loopback
    platform_allow:
      - nrf54l15dk/nrf54l15/cpuapp
```

## tests/lib/ppi_seq/spi/testcase.yaml
```yaml
tests:
  drivers.ppi_seq.spi:
    depends_on: spi
    tags:
      - drivers
      - spi
    harness: ztest
    harness_config:
      fixture: gpio_spi_loopback
    platform_allow:
      - nrf54l15dk/nrf54l15/cpuapp
```

## tests/subsys/ipc/ipc_reconnect/testcase.yaml
```yaml
common:
  tags:
    - subsys
    - ipc
    - ci_tests_subsys_ipc
  sysbuild: true
  harness: console
  harness_config:
    type: multi_line
    regex:
      - "Instance opened"
      - "Endpoint registered"
      - "Waiting for binding"
      - "IPC endpoint bound"
      - "Message 0 sent"
      - "Message 0 received"
      - "Message 1 sent"
      - "Message 1 received"
      - "Message 2 sent"
      - "Message 2 received"
      - "Disconnecting"
      - "IPC endpoint deregistered"
      - "IPC instance closed"
      - "Reconnecting"
      - "Instance opened"
      - "Endpoint registered"
      - "Waiting for binding"
      - "IPC endpoint bound"
      - "Message 2 sent"
      - "Message 2 received"

tests:
  subsys.ipc.ipc_reconnect.cpuapp_cpurad.icmsg:
    platform_allow:
      - nrf5340dk/nrf5340/cpuapp
      - nrf54h20dk/nrf54h20/cpuapp
    integration_platforms:
      - nrf54h20dk/nrf54h20/cpuapp
    extra_args:
      - platform:nrf5340dk/nrf5340/cpuapp:FILE_SUFFIX=icmsg
      - platform:nrf54h20dk/nrf54h20/cpuapp:ipc_reconnect_EXTRA_DTC_OVERLAY_FILE="boards/ipc0_icmsg.overlay"
      - platform:nrf54h20dk/nrf54h20/cpuapp:remote_EXTRA_DTC_OVERLAY_FILE="boards/ipc0_icmsg.overlay"

  subsys.ipc.ipc_reconnect.cpuapp_cpurad.icbmsg:
    platform_allow:
      - nrf54h20dk/nrf54h20/cpuapp
    integration_platforms:
      - nrf54h20dk/nrf54h20/cpuapp
    extra_args:
      - ipc_reconnect_EXTRA_DTC_OVERLAY_FILE="boards/ipc0_unbound.overlay"
      - remote_EXTRA_DTC_OVERLAY_FILE="boards/ipc0_unbound.overlay"

  subsys.ipc.ipc_reconnect.cpuapp_cpuflpr.icmsg:
    extra_args:
      - ipc_reconnect_SNIPPET=nordic-flpr
      - ipc_reconnect_EXTRA_DTC_OVERLAY_FILE="boards/ipc0_icmsg.overlay"
      - remote_EXTRA_DTC_OVERLAY_FILE="boards/ipc0_icmsg.overlay"
    platform_allow:
      - nrf54l15dk/nrf54l15/cpuapp
      - nrf54lm20dk/nrf54lm20a/cpuapp
      - nrf54lm20dk/nrf54lm20b/cpuapp
      - nrf54lv10dk/nrf54lv10a/cpuapp
      - nrf54lc10dk/nrf54lc10a/cpuapp
      - nrf7120dk/nrf7120/cpuapp
    integration_platforms:
      - nrf54l15dk/nrf54l15/cpuapp
      - nrf7120dk/nrf7120/cpuapp

  subsys.ipc.ipc_reconnect.cpuapp_cpuflpr.icbmsg:
    extra_args:
      - ipc_reconnect_SNIPPET=nordic-flpr
      - ipc_reconnect_CONFIG_IPC_SERVICE_BACKEND_ICBMSG_DEINIT=y
      - remote_CONFIG_IPC_SERVICE_BACKEND_ICBMSG_DEINIT=y
    platform_allow:
      - nrf54l15dk/nrf54l15/cpuapp
      - nrf54lm20dk/nrf54lm20a/cpuapp
      - nrf54lm20dk/nrf54lm20b/cpuapp
      - nrf54lv10dk/nrf54lv10a/cpuapp
      - nrf54lc10dk/nrf54lc10a/cpuapp
      - nrf7120dk/nrf7120/cpuapp
    integration_platforms:
      - nrf54l15dk/nrf54l15/cpuapp
      - nrf7120dk/nrf7120/cpuapp

  subsys.ipc.ipc_reconnect.cpuapp_cpuppr.icmsg:
    platform_allow:
      - nrf9251dk/nrf9251/cpuapp
    integration_platforms:
      - nrf9251dk/nrf9251/cpuapp
    extra_args:
      - FILE_SUFFIX=cpuppr
      - ipc_reconnect_SNIPPET=nordic-ppr
      - ipc_reconnect_EXTRA_DTC_OVERLAY_FILE="boards/ipc0_icmsg.overlay"
      - remote_EXTRA_DTC_OVERLAY_FILE="boards/ipc0_icmsg.overlay"

  subsys.ipc.ipc_reconnect.cpuapp_cpuppr.icbmsg:
    platform_allow:
      - nrf9251dk/nrf9251/cpuapp
    integration_platforms:
      - nrf9251dk/nrf9251/cpuapp
    extra_args:
      - FILE_SUFFIX=cpuppr
      - ipc_reconnect_SNIPPET=nordic-ppr
```
